## drivers/sensors/Kconfig
```kconfig
config SENSORS
	bool "Sensors Class Support"
	help
	  This option enables the sensor sysfs class in /sys/class/sensors.
	  You'll need this to do anything useful with sensors. If unsure, say N.

config SENSORS_SSC
	bool "Enable Sensors Driver Support for SSC"
	help
	  Add support for sensors SSC driver.
	  This driver is used for exercising sensors use case,
	  time syncing with ADSP clock.

config SENSORS_CORE
        bool "Sensors Class Support"
        help
          This option enables the sensor sysfs class in /sys/class/sensors.
          You'll need this to do anything useful with sensorss. If unsure, say N.

config SENSORS_K2HH
	depends on I2C
	tristate "SENSORS_K2HH"
	default n
	help
	  Say Y here if you use SENSORS_K2HH.
	  This option enables accelerometer sensors using
	  STMicroelectronic K2HH device driver.

config SENSORS_K2HH_VDD
	depends on SENSORS_K2HH
	tristate "SENSORS_K2HH_VDD"
	default n
	help
	  Say Y here if you use SENSORS_K2HH.
	  This option enables accelerometer sensors using
	  STMicroelectronic K2HH device driver with VDD control.

config SENSORS_STK3013
	depends on I2C
	tristate "STK3013 driver"
	default n
	help
	   This option enables proximity sensors using STK3013 driver.

config SENSORS_YAS537
	tristate "YAS537 Sensor Driver"
	depends on I2C
	default n
	help
	  If you say yes here you get support for YAMAHA
	  YAS537 Geomagnitor Sensor.

config SENSORS_YAS537_DEFAULT_MATRIX
	depends on SENSORS_YAS537
	tristate "The default conpensation matrix for YAS537 softiron"
	default n
	help
	  This option is enables the default matrix for YAS537.
```
